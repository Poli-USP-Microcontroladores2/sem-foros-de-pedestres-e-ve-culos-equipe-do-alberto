/* Overlay para habilitar GPIOE e configurar GPIO do pedestre
 * Não edite o DTS gerado diretamente — este overlay altera o DT em time de build.
 */
/ {
    zephyr,user {
        pedbutton_gpios = <&gpioe 20 GPIO_ACTIVE_HIGH>;
        sync_gpios = <&gpioe 21 GPIO_ACTIVE_HIGH>;
    };
};

&gpioe {
    status = "okay";
};
